## boards/nucleo_l476rg/nucleo_l476rg_defconfig
```kconfig
CONFIG_ARM=y
CONFIG_BOARD_STM32_NUCLEO_L476RG=y
CONFIG_SOC_FAMILY_STM32=y
CONFIG_SOC_SERIES_STM32L4X=y
CONFIG_SOC_STM32L476RG=y
CONFIG_CORTEX_M_SYSTICK=y
# 80MHz system clock
CONFIG_SYS_CLOCK_HW_CYCLES_PER_SEC=80000000

# enable uart driver
CONFIG_SERIAL=y
CONFIG_UART_STM32LX=y
CONFIG_UART_STM32LX_PORT_0=y
CONFIG_UART_STM32LX_PORT_0_BAUD_RATE=115200

# enable pinmux
CONFIG_PINMUX=y
CONFIG_PINMUX_STM32=y

# enable GPIOs
CONFIG_GPIO=y
CONFIG_GPIO_STM32=y
CONFIG_GPIO_STM32_PORTA=y
CONFIG_GPIO_STM32_PORTB=y
CONFIG_GPIO_STM32_PORTB=y
CONFIG_GPIO_STM32_PORTC=y
CONFIG_GPIO_STM32_PORTD=y
CONFIG_GPIO_STM32_PORTE=y
CONFIG_GPIO_STM32_PORTF=y
CONFIG_GPIO_STM32_PORTG=y
CONFIG_GPIO_STM32_PORTH=y

# clock configuration
CONFIG_CLOCK_CONTROL=y
CONFIG_CLOCK_CONTROL_STM32L4X6=y
CONFIG_CLOCK_STM32L4X6_SYSCLK_SRC_PLL=y
# use 16MHz oscillator
CONFIG_CLOCK_STM32F10X_PLL_SRC_HSI=y
# produce 80MHz clock at PLL output
CONFIG_CLOCK_STM32L4X6_PLL_DIVISOR=1
CONFIG_CLOCK_STM32L4X6_PLL_MULTIPLIER=20
CONFIG_CLOCK_STM32L4X6_PLL_P_DIVISOR=7
CONFIG_CLOCK_STM32L4X6_PLL_Q_DIVISOR=2
CONFIG_CLOCK_STM32L4X6_PLL_R_DIVISOR=4
CONFIG_CLOCK_STM32L4X6_AHB_PRESCALER=0
CONFIG_CLOCK_STM32L4X6_APB1_PRESCALER=0
CONFIG_CLOCK_STM32L4X6_APB2_PRESCALER=0

# console
CONFIG_CONSOLE=y
CONFIG_UART_CONSOLE=y
```
